## sdkconfig.defaults
```kconfig
# ─── Flash ────────────────────────────────────────────────────────────────────
CONFIG_ESPTOOLPY_FLASHSIZE_4MB=y

# ─── Partition table ─────────────────────────────────────────────────────────
CONFIG_PARTITION_TABLE_CUSTOM=y
CONFIG_PARTITION_TABLE_CUSTOM_FILENAME="partitions.csv"

# ─── Bluetooth (NimBLE) ───────────────────────────────────────────────────────
CONFIG_BT_ENABLED=y
CONFIG_BT_NIMBLE_ENABLED=y
CONFIG_BT_NIMBLE_ROLE_CENTRAL=n
CONFIG_BT_NIMBLE_ROLE_PERIPHERAL=y
CONFIG_BT_NIMBLE_ROLE_OBSERVER=n
CONFIG_BT_NIMBLE_ROLE_BROADCASTER=n
CONFIG_BT_NIMBLE_MAX_CONNECTIONS=1
CONFIG_BT_NIMBLE_EXT_ADV=y
CONFIG_BT_NIMBLE_ENABLE_CONN_REATTEMPT=n
CONFIG_BT_NIMBLE_HOST_TASK_STACK_SIZE=5120
CONFIG_BT_NIMBLE_MSYS_1_BLOCK_COUNT=12
CONFIG_BT_NIMBLE_MSYS_2_BLOCK_COUNT=4

# ─── WiFi ─────────────────────────────────────────────────────────────────────
# ESP32-C3 shares one 2.4 GHz radio; software coexistence uses TDM.
CONFIG_ESP_COEX_SW_COEXIST_ENABLE=y
CONFIG_ESP_WIFI_SOFTAP_SUPPORT=n

# ─── LwIP / IPv6 — required by Matter ────────────────────────────────────────
# SLAAC disabled: prevents global IPv6 assignment via router advertisement.
# HA matter-server on a different L2 segment (Ethernet vs WiFi) cannot reach
# the device via global IPv6 (NDP fails across L2 boundary). Without a global
# IPv6 address the commissioner falls back to IPv4 (A record) for CASE, which
# routes correctly across VLANs via the gateway.
# IPv6 link-local (FE80::) still works for CHIP-internal use.
CONFIG_LWIP_IPV6_AUTOCONFIG=n
CONFIG_LWIP_HOOK_IP6_ROUTE_DEFAULT=y
CONFIG_LWIP_HOOK_ND6_GET_GW_DEFAULT=y
# One link-local + one unique-local per fabric (max 5 fabrics + 1)
CONFIG_LWIP_IPV6_NUM_ADDRESSES=6

# ─── mbedTLS — HKDF required by Matter for key derivation ───────────────────
CONFIG_MBEDTLS_HKDF_C=y

# ─── Matter ───────────────────────────────────────────────────────────────────
CONFIG_ENABLE_CHIP_SHELL=y
CONFIG_CHIP_PROJECT_CONFIG="main/CHIPProjectConfig.h"
CONFIG_ENABLE_SNTP_TIME_SYNC=y
CONFIG_USE_MINIMAL_MDNS=n
CONFIG_ESP_MATTER_MAX_DYNAMIC_ENDPOINT_COUNT=32

# ─── Console (REPL over USB CDC so bthome_key commands work on COM5) ─────────
CONFIG_ESP_CONSOLE_USB_CDC=y

# ─── Logging ──────────────────────────────────────────────────────────────────
CONFIG_LOG_DEFAULT_LEVEL_INFO=y

# ─── OTA ──────────────────────────────────────────────────────────────────────
CONFIG_BOOTLOADER_APP_ROLLBACK_ENABLE=n
```
